## Kconfig
```kconfig
# SPDX-License-Identifier: MIT

menu "ZMK Soft Off Plus"

config ZMK_SOFT_OFF_PLUS
	bool "ZMK soft-off-plus"
	depends on ZMK_PM_SOFT_OFF
	default y if DT_HAS_ZMK_BEHAVIOR_SOFT_OFF_PLUS_ENABLED
	default y if DT_HAS_ZMK_SOFT_OFF_PLUS_WAKE_ENABLED
	default y if DT_HAS_ZMK_BEHAVIOR_IF_USB_ENABLED
	default y if DT_HAS_ZMK_BEHAVIOR_POWER_BUTTON_ENABLED
	default y if DT_HAS_ZMK_KSCAN_SIDEBAND_BEHAVIORS_ENABLED
	help
	  Umbrella switch for the soft-off-plus module. Each feature below has its
	  own option and also auto-enables when its devicetree node is present, so
	  normally you only add the nodes you want. Requires ZMK soft off
	  (CONFIG_ZMK_PM_SOFT_OFF).

if ZMK_SOFT_OFF_PLUS

#
# Feature 1: enhanced soft-off behavior (+ optional split "both halves off")
#
config ZMK_SOFT_OFF_PLUS_BEHAVIOR
	bool "Enhanced soft-off behavior (zmk,behavior-soft-off-plus)"
	default y if DT_HAS_ZMK_BEHAVIOR_SOFT_OFF_PLUS_ENABLED
	help
	  Compile the &soft_off_plus behavior. It times its hold on whichever half
	  runs it; bind it from a keymap or a dedicated power/soft-off key.

config ZMK_SOFT_OFF_PLUS_SPLIT_SYNC
	bool "Power off both split halves together"
	depends on ZMK_SOFT_OFF_PLUS_BEHAVIOR && ZMK_SPLIT_BLE && BT
	default y if ZMK_SPLIT_BLE
	help
	  Triggering soft-off-plus on either half powers off both, via a dedicated
	  GATT characteristic (the central writes an off command to its
	  peripheral(s); a peripheral notifies the central).

config ZMK_SOFT_OFF_PLUS_SPLIT_SYNC_FLUSH_MS
	int "BLE off-signal flush delay (ms)"
	depends on ZMK_SOFT_OFF_PLUS_SPLIT_SYNC
	default 60
	help
	  Wait this long after sending the cross-half off signal before powering
	  off, so the BLE write/notification is transmitted first.

#
# Feature 2: boot-time "hold to wake" delay
#
config ZMK_SOFT_OFF_PLUS_WAKE_DELAY
	bool "Require a long press to wake from soft off"
	default y if DT_HAS_ZMK_SOFT_OFF_PLUS_WAKE_ENABLED
	select HWINFO
	select POWEROFF
	help
	  After waking from soft off (a System OFF reset on nRF), poll the wake
	  GPIO(s) and only continue booting if they stay active for wake-hold-ms;
	  otherwise re-arm the wake source and return to System OFF immediately.
	  Configure with a zmk,soft-off-plus-wake devicetree node.

config ZMK_SOFT_OFF_PLUS_WAKE_DELAY_INIT_PRIORITY
	int "Wake-delay boot check init priority (POST_KERNEL)"
	depends on ZMK_SOFT_OFF_PLUS_WAKE_DELAY
	default 50
	help
	  POST_KERNEL priority of the boot-time hold check. It must run before the
	  kscan that owns the wake pins; for a matrix wake key set this low (e.g. 1).

#
# Feature 3: USB-conditional wrapper (e.g. bootloader on the power key)
#
config ZMK_SOFT_OFF_PLUS_IF_USB
	bool "USB-conditional wrapper behavior (zmk,behavior-if-usb)"
	default y if DT_HAS_ZMK_BEHAVIOR_IF_USB_ENABLED
	help
	  Compile zmk,behavior-if-usb, which forwards to a child behavior only while
	  USB is powered on the half that runs it. Use it on a dedicated
	  power/soft-off key to gate &bootloader so DFU is only reachable on the
	  half that is plugged in.

#
# Feature 4: split-safe dedicated power-button gesture
#
config ZMK_SOFT_OFF_PLUS_POWER_BUTTON
	bool "Split-safe sideband power-button gesture"
	default y if DT_HAS_ZMK_BEHAVIOR_POWER_BUTTON_ENABLED
	help
	  Compile zmk,behavior-power-button, a dedicated sideband gesture that
	  invokes its first child after a held first press and its second child on
	  the third quick press. It deliberately has no global key-position event
	  listener, so normal peripheral matrix events continue directly to the
	  split transport.

#
# Deep-sleep wake sources
#
config ZMK_SOFT_OFF_PLUS_DEEP_SLEEP_WAKE
	bool "Keep sideband and matrix scanners armed during deep sleep"
	depends on ZMK_SLEEP && PM_DEVICE
	default y if DT_HAS_ZMK_KSCAN_SIDEBAND_BEHAVIORS_ENABLED || DT_HAS_ZMK_KSCAN_GPIO_MATRIX_ENABLED
	help
	  Explicitly wake-enable status-okay sideband wrappers, their inner scanners,
	  and GPIO matrix scanners during late application initialization. This keeps
	  ZMK's inactivity deep-sleep suspend pass from suspending the sideband
	  wrapper and disarming the GPIO that should wake the keyboard.

config ZMK_SOFT_OFF_PLUS_DEEP_SLEEP_WAKE_INIT_PRIORITY
	int "Deep-sleep wake-source init priority"
	depends on ZMK_SOFT_OFF_PLUS_DEEP_SLEEP_WAKE
	range 0 99
	default 99
	help
	  APPLICATION initialization priority for arming the scanners. Keep this
	  later than ZMK's physical-layout and sideband auto-enable initialization.

#
# Shutdown display blank (used by the hold-stage visual confirmation)
#
config ZMK_SOFT_OFF_PLUS_BLANK_INVERTED
	bool "Draw the shutdown blank with LVGL black instead of white"
	depends on ZMK_DISPLAY && LVGL
	help
	  The hold-stage blank falls back to covering the screen with an opaque
	  LVGL-white object when the display driver has no blanking support. Some
	  monochrome pipelines render LVGL colors inverted on the panel: on ZMK's
	  Zephyr 4.1 / LVGL 9 stack, a MONO01 panel (Sharp LS0xx / nice!view)
	  shows LVGL white as black. Enable this so the blank is drawn with LVGL
	  black and such panels clear to white.

module = ZMK_SOFT_OFF_PLUS
module-str = "ZMK Soft Off Plus"
source "subsys/logging/Kconfig.template.log_config"

endif # ZMK_SOFT_OFF_PLUS

endmenu
```
